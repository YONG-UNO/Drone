#include "ui.h"
#include "cmsis_os.h"
#include "stm32f4xx_hal.h"
#include "usart.h"
#include <stdint.h>

static const uint8_t CRC8_Table[] = {
    0x00,0x31,0x62,0x53,0xC4,0xF5,0xA6,0x97,0xB9,0x88,0xDB,0xEA,0x7D,0x4E,0x1D,0x2C,
    0x43,0x72,0x21,0x10,0x87,0xB6,0xE5,0xD4,0xFA,0xCB,0x98,0xA9,0x3E,0x0F,0x5C,0x6D,
    0x86,0xB7,0xE4,0xD5,0x42,0x73,0x20,0x11,0x3F,0x0E,0x5D,0x6C,0xFB,0xCA,0x99,0xA8,
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    0xEF,0xDE,0x8D,0xBC,0x2B,0x1A,0x49,0x78,0x56,0x67,0x34,0x05,0x92,0xAC,0xAF,0xF0,
};

static uint8_t Get_CRC8(uint8_t *pData, uint32_t len)
{
    uint8_t check = 0;
    while(len--)
    {
        check = CRC8_Table[check ^ *pData];
        pData++;
    }
    return check;
}

static uint16_t Get_CRC16(uint8_t *pData, uint32_t len)
{
    uint16_t check = 0xFFFF;
    uint32_t i;
    while(len--)
    {
        check ^= *pData++;
        for(i=0; i<8; i++)
        {
            if(check & 1) check = (check >> 1) ^ 0xA001;
            else check >>= 1;
        }
    }
    return check;
}

void ui_send_packet(uint16_t cmd_id, uint8_t *data, uint16_t data_len) {
    uint8_t buf[128] = {0};
    uint16_t total_len = 0;

    buf[0] = 0xA5;
    buf[1] = data_len & 0xFF;
    buf[2] = (data_len >> 8) & 0xFF;
    buf[3] = 0x01;
    buf[4] = Get_CRC8(buf,4);
    total_len = 5;

    buf[total_len++] = cmd_id & 0xFF;
    buf[total_len++] = (cmd_id >> 8) & 0xFF;

    for (uint16_t i = 0; i < data_len; i++) {
        buf[total_len++] = data[i];
    }

    uint16_t crc16 = Get_CRC16(buf, total_len);
    buf[total_len++] = crc16 & 0xFF;
    buf[total_len++] = (crc16 >> 8) & 0xFF;

    HAL_UART_Transmit(&huart1, buf, total_len, 100);
}
// 清屏 0x0300
void ui_clear(void)
{
    uint8_t data[2] = {0x01, 0x01};
    ui_send_packet(0x0300, data, 2);
    osDelay(20);
}

void ui_red_circle(void) {
    uint8_t data[21] = {
        0x01,0x01,
        0x01,0x00,
        0x01,0x01,
        'C','1',0,
        0x00,       // 操作
        0x02,       // 圆
        0x00,       // 图层
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        0x50,0x00,   // R=80
        0x00
    };

    ui_send_packet(0x0301,data,21);
}